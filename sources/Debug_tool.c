/********************************
文件名称：Debug_tool调试工具程序
作者：无协摄像头一队
版本：V1.0
说明：智能车调试工具程序
修改记录：
2015.5.23整理完成
********************************/
#include "Debug_tool.h"
#include  "stdio.h"
 //液晶显示字符表
 const unsigned char font6x8[][6] =  
	{
  	{ 0x00, 0x00, 0x00, 0x00, 0x00, 0x00 },// sp
  	{ 0x00, 0x00, 0x00, 0x2f, 0x00, 0x00 },// !
  	{ 0x00, 0x00, 0x07, 0x00, 0x07, 0x00 },// "
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  	{ 0x14, 0x14, 0x14, 0x14, 0x14, 0x14 }// horiz lines
};

const uint8 F14x16_Idx[] = 
{
	"无协摄像头一队"
};

//======================================================
// 128X64I液晶底层驱动[8X16]字体库
// 设计者: powerint
// 描  述: [8X16]西文字符的字模数据 (纵向取模,字节倒序)
// !"#$%&'()*+,-./0123456789:;<=>?@ABCDEFGHIJKLMNOPQRSTUVWXYZ[\]^_`abcdefghijklmnopqrstuvwxyz{|}~
//======================================================
const 	uint8 F8X16[]=
{
	0x00,0x00,0x00,0x00,0x00,0x00,0x00,0x00,0x00,0x00,0x00,0x00,0x00,0x00,0x00,0x00,// 0
  0x00,0x00,0x00,0xF8,0x00,0x00,0x00,0x00,0x00,0x00,0x00,0x33,0x30,0x00,0x00,0x00,//!1
  0x00,0x10,0x0C,0x06,0x10,0x0C,0x06,0x00,0x00,0x00,0x00,0x00,0x00,0x00,0x00,0x00,//"2
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  0x00,0x06,0x01,0x01,0x02,0x02,0x04,0x04,0x00,0x00,0x00,0x00,0x00,0x00,0x00,0x00,//~94

};


const uint8 F14x16[] =
{
	/*--  文字:  无  --*/
/*--  黑体11;  此字体下对应的点阵为：宽x高=14x14   --*/
/*--  高度不是8的倍数，现调整为：宽度x高度=14x16  --*/
0x00,0x40,0x44,0x44,0x44,0xFC,0xFC,0xFC,0xC4,0x44,0x44,0x44,0x40,0x00,0x10,0x10,
0x18,0x1C,0x0F,0x07,0x03,0x1F,0x1F,0x18,0x10,0x1C,0x1C,0x00,

/*--  文字:  协  --*/
/*--  黑体11;  此字体下对应的点阵为：宽x高=14x14   --*/
/*--  高度不是8的倍数，现调整为：宽度x高度=14x16  --*/
0x10,0xFE,0xFE,0xFE,0x90,0xD0,0xD0,0xFE,0xFE,0x12,0xF0,0xF0,0xC0,0x00,0x00,0x1F,
0x1F,0x1F,0x19,0x1D,0x1F,0x07,0x13,0x1F,0x1F,0x0F,0x01,0x00,

/*--  文字:  摄  --*/
/*--  黑体11;  此字体下对应的点阵为：宽x高=14x14   --*/
/*--  高度不是8的倍数，现调整为：宽度x高度=14x16  --*/
0x88,0x88,0xFE,0xFE,0x4A,0x4A,0x7E,0x7E,0x5A,0x5A,0xFE,0xFE,0x42,0x00,0x10,0x10,
0x1F,0x1F,0x13,0x1F,0x1F,0x1F,0x1B,0x1F,0x1F,0x1F,0x17,0x00,

/*--  文字:  像  --*/
/*--  黑体11;  此字体下对应的点阵为：宽x高=14x14   --*/
/*--  高度不是8的倍数，现调整为：宽度x高度=14x16  --*/
0x60,0x78,0xFE,0xFE,0x3A,0xFC,0xFE,0xF6,0xFE,0x7C,0xDC,0xF0,0xB0,0x00,0x00,0x00,
0x1F,0x1F,0x1D,0x1F,0x1F,0x3F,0x3F,0x1F,0x0F,0x0F,0x0C,0x00,

/*--  文字:  头  --*/
/*--  黑体11;  此字体下对应的点阵为：宽x高=14x14   --*/
/*--  高度不是8的倍数，现调整为：宽度x高度=14x16  --*/
0x80,0xB0,0xB4,0xF6,0xEE,0xCC,0x88,0xFE,0xFE,0x86,0x80,0x80,0x80,0x00,0x00,0x30,
0x30,0x18,0x18,0x0C,0x0F,0x07,0x05,0x0C,0x0C,0x18,0x18,0x00,

/*--  文字:  一  --*/
/*--  黑体11;  此字体下对应的点阵为：宽x高=14x14   --*/
/*--  高度不是8的倍数，现调整为：宽度x高度=14x16  --*/
0xC0,0xC0,0x40,0x40,0x40,0x40,0x40,0x40,0x40,0x40,0x40,0x40,0xC0,0x00,0x00,0x00,
0x00,0x00,0x00,0x00,0x00,0x00,0x00,0x00,0x00,0x00,0x00,0x00,

/*--  文字:  队  --*/
/*--  黑体11;  此字体下对应的点阵为：宽x高=14x14   --*/
/*--  高度不是8的倍数，现调整为：宽度x高度=14x16  --*/
0x06,0xFE,0xFE,0x7A,0xFE,0xDE,0x02,0xFE,0xFE,0xFE,0x80,0x00,0x00,0x00,0x10,0x1F,
0x1F,0x14,0x17,0x1F,0x1F,0x0F,0x03,0x03,0x0F,0x1E,0x18,0x10,


};
/****************************不使用汉字 屏蔽掉**********************************/
/*
const uint8 F14x16[] = {
  
};*/
//延时函数
static void Delay_ms(uint16 ms)      //延时一毫秒
{
   int ii,jj;
   if (ms<1) ms=1;
   for(ii=0;ii<ms;ii++)     
   for(jj=0;jj<6676;jj++)
   {
   	
   }
    //80MHz--1ms  
}  

/*********************************************************** 
函数名称：LCD_write_byte
函数功能：模拟SPI接口时序写数据/命令LCD
入口参数：Data    ：写入的数据；
          Command ：写数据/命令选择；
出口参数：无 
***********************************************************/
static void LCD_write_byte(unsigned char Data, unsigned char Command)
{
    unsigned char i;
	LCD_CE_0; 	//CE=0	     //5110片选有效，允许输入数据
	
	if(Command==1)                     //DC=Command
	   	LCD_DC_1;
    else
    	LCD_DC_0;    
    
	for(i=0;i<8;i++)				     //传送8bit数据
	{ 
			if(Data&0x80)
			 	SDIN_1;
			else
			    SDIN_0;   
			
			Data = (Data <<1);
			SCLK_0; 
     
			SCLK_1;
			 
	}
    LCD_DC_1;           //	DC=1;
    LCD_CE_1; 			//CE=1;  
    SDIN_1;			// Din=1;
					  
}
/**********************************************************
函数名称：LCD_write_char
函数功能：显示英文字符
入口参数：c	:  显示的字符
出口参数：无 
***********************************************************/
void LCD_write_char(unsigned char c)
{
    unsigned char line;
    c -= 32;                       //数组的行号
  	LCD_CE_0;			//  CE=0;

    for (line=0; line<6; line++)
        LCD_write_byte(font6x8[c][line], 1);
}

 /*********************************************************
函数名称：LCD_write_str
函数功能：显示字符串函数
入口参数：p	:  显示的字符串
出口参数：无 
***********************************************************/
static void LCD_write_str(unsigned char *p)
{
	while(*p!='\0')
	{
		LCD_write_char(*p);
		p++;
	}
}
/*********************************************************** 
函数名称：LCD_set_XY
函数功能：设置LCD坐标函数
入口参数：X       ：0－83
          Y       ：0－5
出口参数：无 
***********************************************************/
void LCD_set_XY(unsigned char X, unsigned char Y)
{
    LCD_write_byte(0x40 | Y,0 );		  // column
    LCD_write_byte(0x80 | X,0 );        // row
}
 /**********************************************************
函数名称：LCD_clear
函数功能：LCD清屏函数 
入口参数：无
出口参数：无  
***********************************************************/
void LCD_clear(void) 
{ 
 unsigned char t; 
 unsigned char k; 
 LCD_set_XY(0,0); 
 for(t=0;t<6;t++) 
	  {  
		   for(k=0;k<84;k++) 
		   {  
		    LCD_write_byte(0x00,1);   
		   }  
	  } 
} 
 /**********************************************************
函数名称：show_num
函数功能：LCD参数显示函数 
入口参数：
1>坐标 x,y   数字 num
2>数字num(自动空格)
出口参数：无  
***********************************************************/
//1
void show_num(int x,int y,int num )
{
	int ttt,b,c,xx,yy;
	xx=x;
	yy=y;
	ttt=1;
	LCD_set_XY(xx,yy);
	if(num<0)
	{
		LCD_write_char('-');
		num=-num;	
	}
	c=num;
	for(;num>=10;num=num/10)
	{
		ttt*=10;
	}
	while(ttt >=1)
	{
		b = c / ttt;
		c = c - b * ttt;
		LCD_write_char(b+48);
		
		ttt=ttt/10;
	}
}
/**********************************************************
函数名称：LCD_picture_hang
函数功能：LCD图像 
入口参数：坐标(x,y)  LCD_high(LCD起始行数)  Image_length(image数组长度)   
出口参数：无  
***********************************************************/
static void LCD_picture_hang(unsigned char X,unsigned char Y,unsigned char LCD_high,uint8*Image_,uint8 Image_length)
{
    unsigned int i;
    signed int n;
    unsigned char *p;
    unsigned char CCD_temp[84];
    p=CCD_temp;
    //构造5110显示数组
    for (n=0;n<160;n=n+2)
    {
        *p = (Image_[n+LCD_high*Image_length]-254) +(Image_[n+(LCD_high+1)*Image_length]-254)*2+ 
        	 (Image_[n+(LCD_high+2)*Image_length]-254)*4+ (Image_[n+(LCD_high+3)*Image_length]-254)*8+
             (Image_[n+(LCD_high+4)*Image_length]-254)*16+(Image_[n+(LCD_high+5)*Image_length]-254)*32+
             (Image_[n+(LCD_high+6)*Image_length]-254)*64+(Image_[n+(LCD_high+7)*Image_length]-254)*128;    
        p++;
    }
    LCD_set_XY(X,Y);
    //显示一行图像
    for(i=0; i<80; i++)
    {
    	LCD_write_byte(~CCD_temp[i], 1);
    }
}
static void LCD_show_all_long(unsigned char X,unsigned char Y,unsigned char LCD_high,uint8*Image_,uint8 Image_length,int16 *center)
{
	unsigned int i;
	signed int n;
	int temp=1;
	unsigned char *p;
	unsigned char CCD_temp[84];
	p=CCD_temp;
	//构造5110显示数组
	for (n=0;n<160;n=n+2)
   	{
        *p = (Image_[n+LCD_high*Image_length]-254) +(Image_[n+(LCD_high+1)*Image_length]-254)*2+ 
        	 (Image_[n+(LCD_high+2)*Image_length]-254)*4+ (Image_[n+(LCD_high+3)*Image_length]-254)*8+
            (Image_[n+(LCD_high+4)*Image_length]-254)*16+(Image_[n+(LCD_high+5)*Image_length]-254)*32+
             (Image_[n+(LCD_high+6)*Image_length]-254)*64+(Image_[n+(LCD_high+7)*Image_length]-254)*128;    
        p++;
    }
    LCD_set_XY(X,Y);
    //显示一行图像
    for(i=0; i<80; i++)
    {
    	CCD_temp[i]=~CCD_temp[i];
    }
    temp=1;
    for(n=0;n<8;n++)
	{
		if(((center[LCD_high])/2) > 80)
		{
			CCD_temp[80] = CCD_temp[80]  ^ temp;	
		} 
		else if(((center[LCD_high])/2) < 0 )
		{
			CCD_temp[0]  = CCD_temp[0]  ^ temp;
		}
		else
		{
			CCD_temp[((center[LCD_high])/2)] = CCD_temp[((center[LCD_high])/2)] ^ temp;	
		}
		temp=temp*2;
		LCD_high++;	
	}
	for(i=0; i<80; i++)
    {
    	LCD_write_byte(CCD_temp[i], 1);
    }	
}
/**********************************************************
函数名称：LCD_show_center
函数功能：LCD中线显示函数 
入口参数：center中线数组
出口参数：无  
编写方法：遍历整个数组；
***********************************************************/
void LCD_show_center(int16 *center,int start,int16 *center_l,int16 *center_r)
{
	int m,n,temp,h=start;
	int16 CCD_temp[84];//缓存数组
	for(n=0;n<84;n++)
	{
		CCD_temp[n]=0;	
	}
	LCD_clear();
	for(m=0;m<7;m++)
	{
		temp=1;
		for(n=0;n<8;n++)
		{
			if(42+(center[h]/2) > 83)
				CCD_temp[83]+=temp;
			else if(42+(center[h]/2) < 0)
				CCD_temp[0]+=temp;
			else
				CCD_temp[42+(center[h]/2)]+=temp;
			
			if(42+(center_r[h]/2) > 83)
				CCD_temp[83]+=temp;
			else if(42+(center_r[h]/2) < 0)
				CCD_temp[0]+=temp;
			else
				CCD_temp[42+(center_r[h]/2)]+=temp;
			
			if(42+(center_l[h]/2) > 83)
				CCD_temp[83]+=temp;
			else if(42+(center_l[h]/2) < 0)
				CCD_temp[0]+=temp;
			else
				CCD_temp[42+(center_l[h]/2)]+=temp;

			temp=temp*2;
			h++;	
		}
		for(n=0;n<84;n++)
		{
			if(CCD_temp[n]!=0)
			{
				LCD_set_XY(n,m);
				LCD_write_byte(CCD_temp[n],1);
				CCD_temp[n]=0x00;//还原数据点
			}		
		}
	}
}
/**********************************************************
函数名称：LCD_picture
函数功能：LCD展示函数 
入口参数：I图像数组 length(image数组长度)   
出口参数：无  
***********************************************************/
void LCD_picture(uint8*I,uint8 length,int8 D_start)
{
	int i;
	for(i=0;i<(60-D_start)/8;i++)
	{
		LCD_picture_hang(0,i,D_start+i*8,I,length);
	}
}
/**********************************************************
函数名称：LCD_show_all
函数功能：LCD图像及中线显示函数 
入口参数：image 图像数组   length数组长度  center中线数组 D_start展示部分图像起始行数
出口参数：无  
编写方法：遍历整个数组；
***********************************************************/
void LCD_show_all(uint8*I,uint8 length,int16 *center,int8 D_start)
{
	int i=0;
	for(i=0;i<(60-D_start)/8;i++)
	{
		LCD_show_all_long(0,i, D_start+i*8,I,length,center);
	}
}
/**********************************************************
函数名称：LCD_clear_line
函数功能：LCD清屏函数
入口参数：num清除某一行
出口参数：无  
***********************************************************/
void LCD_clear_line(int8 num)
{
	LCD_set_XY(0,num);
	LCD_write_char(' ');LCD_write_char(' ');
    LCD_write_char(' ');LCD_write_char(' ');
    LCD_write_char(' ');LCD_write_char(' ');
  	LCD_write_char(' ');LCD_write_char(' ');	
  	LCD_write_char(' ');LCD_write_char(' ');
    LCD_write_char(' ');LCD_write_char(' ');
    LCD_write_char(' ');LCD_write_char(' ');	
	LCD_write_char(' ');LCD_write_char(' ');	
}

/*********************************************************** 
函数名称：uart0_putchar
函数功能：发送字符函数
入口参数：字符
出口参数：无  
***********************************************************/
static void uart0_putchar(uint8 c)
{
//Wait until space is available in the FIFO 
    while (!(MCF_UART0_USR&MCF_UART_USR_TXRDY)) 
    {
    	;
    }

    //Send the character 
    MCF_UART0_UTB = c;
}
/*********************************************************** 
函数名称：uart0_putstr
函数功能：发送字符串函数
入口参数：str
出口参数：无  
***********************************************************/
static void uart0_putstr(uint8*str,int count)
{
	while(count--)
	{
	 uart0_putchar(*str++);
	}
}
/*********************************************************** 
函数名称：uart0_putpicture
函数功能：发送图像函数串口照相机
入口参数：无
出口参数：无  
***********************************************************/
void uart0_putpicture()
{
	if(jishu==600)
	{
		jishu=0;
		for(row=0;row<ROW;row++)
		{
			for(line=0;line<LINE;line++)
			{
				if(image[row][line]==255)
				{
					uart0_putchar(255);	
				}
				if(image[row][line]==254)
				{
					uart0_putchar(0);
				}
						
			}
				//	uart0_putchar('\n');			
		}						
	}		
}

/*********************************************************** 
函数名称：uart0_putpicture0
函数功能：发送图像数据智能车助手----------v1.0
入口参数：
出口参数：无  
***********************************************************/
void uart0_putpicture0()
{
	if(jishu == 200)
	{
		jishu = 0;
		uart0_putchar(0x01);
		uart0_putchar(0xfe);
		for(row=0;row<ROW;row++)
		{
			for(line=0;line<LINE;line++)
			{
				if(image[row][line]==255)
				{
					uart0_putchar(0Xbb);	
				}
				if(image[row][line]==254)
				{
					uart0_putchar(0X00);
				}
							
			}			
		}
		uart0_putchar(0xfe);
		uart0_putchar(0x01);
	}
}

/*********************************************************** 
函数名称：uart0_putdata
函数功能：虚拟示波器智能车助手----------v1.0
入口参数：num/data
出口参数：无  
***********************************************************/
void uart0_putdata(int num,int *data)
{
	int i;
	uart0_putchar(0x03);
	uart0_putchar(0xfc);
	for(i=0;i<num;i++)
	{
		uart0_putchar(data[i]);	
	}
	uart0_putchar(0xfc);
	uart0_putchar(0x03);
}
///////////////////////////////////////////////////////
///////////////////////////////////////////////////////
//以下是OLED部分
void LCD_WrDat(unsigned char data)
{
	unsigned char i=8;
	//LCD_CS=0;;
	SET_LCD_DC;;asm("nop");
  CLR_LCD_SCL;;asm("nop");
  asm("nop");asm("nop");    
  while(i--)
  {
    if(data&0x80){SET_LCD_SDA;asm("nop");}
    else{CLR_LCD_SDA;asm("nop");}
    SET_LCD_SCL; 
    asm("nop");;
		asm("nop");  asm("nop");          
    CLR_LCD_SCL;; asm("nop");
    data<<=1;    asm("nop");
  }
	//LCD_CS=1;
}
void LCD_WrCmd(unsigned char cmd)
{
	unsigned char i=8;
	
	//LCD_CS=0;;
	CLR_LCD_DC;;asm("nop");
  CLR_LCD_SCL;;asm("nop");
  asm("nop");   asm("nop");
  while(i--)
  {
    if(cmd&0x80){SET_LCD_SDA;asm("nop");}
    else{CLR_LCD_SDA;;asm("nop");}
    SET_LCD_SCL;;asm("nop");
    asm("nop");;
		asm("nop");  asm("nop");          
    CLR_LCD_SCL;;   asm("nop"); 
    cmd<<=1;;   asm("nop");
  } 	
	//LCD_CS=1;
}

void LCD_Set_Pos(uint8 x, uint8 y)
{ 
  LCD_WrCmd(0xb0+y);
  LCD_WrCmd(((x&0xf0)>>4)|0x10);
  LCD_WrCmd((x&0x0f)|0x01); 
} 
void LCD_Fill(uint8 bmp_data)
{
	uint8 y,x;
	
	for(y=0;y<8;y++)
	{
		LCD_WrCmd(0xb0+y);
		LCD_WrCmd(0x01);
		LCD_WrCmd(0x10);
		for(x=0;x<X_WIDTH;x++)
			LCD_WrDat(bmp_data);
	}
}
void LCD_CLS(void)
{
	uint8 y,x;	
	for(y=0;y<8;y++)
	{
		LCD_WrCmd(0xb0+y);
		LCD_WrCmd(0x01);
		LCD_WrCmd(0x10); 
		for(x=0;x<X_WIDTH;x++)
			LCD_WrDat(0);
	}
}
void LCD_DLY_ms(uint16 ms)
{                         
  uint16 a;
  while(ms)
  {
    //a=1335;   //32MHz sys_clk
    a=3500;
    while(a--);
    ms--;
  }
  return;
}
void adjust(uint8 a)
{
  LCD_WrCmd(a);	//指令数据0x0000~0x003f  
}
void SetStartColumn(unsigned char d)
{
	LCD_WrCmd(0x00+d%16);		// Set Lower Column Start Address for Page Addressing Mode
						//   Default => 0x00
	LCD_WrCmd(0x10+d/16);		// Set Higher Column Start Address for Page Addressing Mode
						//   Default => 0x10
}

void SetAddressingMode(unsigned char d)
{
	LCD_WrCmd(0x20);			// Set Memory Addressing Mode
	LCD_WrCmd(d);			//   Default => 0x02
						//     0x00 => Horizontal Addressing Mode
						//     0x01 => Vertical Addressing Mode
						//     0x02 => Page Addressing Mode
}

void SetColumnAddress(unsigned char a, unsigned char b)
{
	LCD_WrCmd(0x21);			// Set Column Address
	LCD_WrCmd(a);			//   Default => 0x00 (Column Start Address)
	LCD_WrCmd(b);			//   Default => 0x7F (Column End Address)
}

void SetPageAddress(unsigned char a, unsigned char b)
{
	LCD_WrCmd(0x22);			// Set Page Address
	LCD_WrCmd(a);			//   Default => 0x00 (Page Start Address)
	LCD_WrCmd(b);			//   Default => 0x07 (Page End Address)
}

void SetStartLine(unsigned char d)
{
	LCD_WrCmd(0x40|d);			// Set Display Start Line
						//   Default => 0x40 (0x00)
}

void SetContrastControl(unsigned char d)
{
	LCD_WrCmd(0x81);			// Set Contrast Control
	LCD_WrCmd(d);			//   Default => 0x7F
}

void Set_Charge_Pump(unsigned char d)
{
	LCD_WrCmd(0x8D);			// Set Charge Pump
	LCD_WrCmd(0x10|d);			//   Default => 0x10
						//     0x10 (0x00) => Disable Charge Pump
						//     0x14 (0x04) => Enable Charge Pump
}

void Set_Segment_Remap(unsigned char d)
{
	LCD_WrCmd(0xA0|d);			// Set Segment Re-Map
						//   Default => 0xA0
						//     0xA0 (0x00) => Column Address 0 Mapped to SEG0
						//     0xA1 (0x01) => Column Address 0 Mapped to SEG127
}

void Set_Entire_Display(unsigned char d)
{
	LCD_WrCmd(0xA4|d);			// Set Entire Display On / Off
						//   Default => 0xA4
						//     0xA4 (0x00) => Normal Display
						//     0xA5 (0x01) => Entire Display On
}

void Set_Inverse_Display(unsigned char d)
{
	LCD_WrCmd(0xA6|d);			// Set Inverse Display On/Off
						//   Default => 0xA6
						//     0xA6 (0x00) => Normal Display
						//     0xA7 (0x01) => Inverse Display On
}

void Set_Multiplex_Ratio(unsigned char d)
{
	LCD_WrCmd(0xA8);			// Set Multiplex Ratio
	LCD_WrCmd(d);			//   Default => 0x3F (1/64 Duty)
}

void Set_Display_On_Off(unsigned char d)
{
	LCD_WrCmd(0xAE|d);			// Set Display On/Off
						//   Default => 0xAE
						//     0xAE (0x00) => Display Off
						//     0xAF (0x01) => Display On
}

void SetStartPage(unsigned char d)
{
	LCD_WrCmd(0xB0|d);			// Set Page Start Address for Page Addressing Mode
						//   Default => 0xB0 (0x00)
}

void Set_Common_Remap(unsigned char d)
{
	LCD_WrCmd(0xC0|d);			// Set COM Output Scan Direction
						//   Default => 0xC0
						//     0xC0 (0x00) => Scan from COM0 to 63
						//     0xC8 (0x08) => Scan from COM63 to 0
}

void Set_Display_Offset(unsigned char d)
{
	LCD_WrCmd(0xD3);			// Set Display Offset
	LCD_WrCmd(d);			//   Default => 0x00
}

void Set_Display_Clock(unsigned char d)
{
	LCD_WrCmd(0xD5);			// Set Display Clock Divide Ratio / Oscillator Frequency
	LCD_WrCmd(d);			//   Default => 0x80
						//     D[3:0] => Display Clock Divider
						//     D[7:4] => Oscillator Frequency
}

void Set_Precharge_Period(unsigned char d)
{
	LCD_WrCmd(0xD9);			// Set Pre-Charge Period
	LCD_WrCmd(d);			//   Default => 0x22 (2 Display Clocks [Phase 2] / 2 Display Clocks [Phase 1])
						//     D[3:0] => Phase 1 Period in 1~15 Display Clocks
						//     D[7:4] => Phase 2 Period in 1~15 Display Clocks
}

void Set_Common_Config(unsigned char d)
{
	LCD_WrCmd(0xDA);			// Set COM Pins Hardware Configuration
	LCD_WrCmd(0x02|d);			//   Default => 0x12 (0x10)
						//     Alternative COM Pin Configuration
						//     Disable COM Left/Right Re-Map
}

void Set_VCOMH(unsigned char d)
{
	LCD_WrCmd(0xDB);			// Set VCOMH Deselect Level
	LCD_WrCmd(d);			//   Default => 0x20 (0.77*VCC)
}

void Set_NOP(void)
{
	LCD_WrCmd(0xE3);			// Command for No Operation
}

void LCD_Init(void)        
{
  SET_LCD_SCL;
  //LCD_CS=1;	//预制SLK和SS为高电平   	

  CLR_LCD_RST;
  LCD_DLY_ms(50);
  SET_LCD_RST;
	
	//从上电到下面开始初始化要有足够的时间，即等待RC复位完毕
  Set_Display_On_Off(0x00);	LCD_DLY_ms(10);	  // Display Off (0x00/0x01)
  Set_Display_Clock(0x80);	LCD_DLY_ms(10);	  // Set Clock as 100 Frames/Sec
  Set_Multiplex_Ratio(0x3F);LCD_DLY_ms(10);		// 1/64 Duty (0x0F~0x3F)
  Set_Display_Offset(0x00);	LCD_DLY_ms(10);	  // Shift Mapping RAM Counter (0x00~0x3F)
  SetStartLine(0x00);	LCD_DLY_ms(10);		      // Set Mapping RAM Display Start Line (0x00~0x3F)
  Set_Charge_Pump(0x04);LCD_DLY_ms(10);		    // Enable Embedded DC/DC Converter (0x00/0x04)
  SetAddressingMode(0x02);LCD_DLY_ms(10);		  // Set Page Addressing Mode (0x00/0x01/0x02)
  Set_Segment_Remap(0x01);LCD_DLY_ms(10);		  // Set SEG/Column Mapping     0x00左右反置 0x01正常
  Set_Common_Remap(0x08);LCD_DLY_ms(10);			  // Set COM/Row Scan Direction 0x00上下反置 0x08正常
  Set_Common_Config(0x10);LCD_DLY_ms(10);		  // Set Sequential Configuration (0x00/0x10)
  SetContrastControl(Brightness);LCD_DLY_ms(10);	// Set SEG Output Current
  Set_Precharge_Period(0xF1);LCD_DLY_ms(10);		// Set Pre-Charge as 15 Clocks & Discharge as 1 Clock
  Set_VCOMH(0x40);		LCD_DLY_ms(10);	        // Set VCOM Deselect Level
  Set_Entire_Display(0x00);	LCD_DLY_ms(10);	  // Disable Entire Display On (0x00/0x01)
  Set_Inverse_Display(0x00);LCD_DLY_ms(10);		// Disable Inverse Display On (0x00/0x01)  
  Set_Display_On_Off(0x01);	LCD_DLY_ms(10);	  // Display On (0x00/0x01)
  LCD_Fill(0x00); LCD_DLY_ms(10); //初始清屏
	LCD_Set_Pos(0,0); LCD_DLY_ms(10);
	
  /*
  LCD_WrCmd(0xae);//--turn off oled panel
  LCD_WrCmd(0x00);//---set low column address
  LCD_WrCmd(0x10);//---set high column address
  LCD_WrCmd(0x40);//--set start line address
  LCD_WrCmd(0x81);//--set contrast control register
  LCD_WrCmd(0xcf);
  LCD_WrCmd(0xa1);//--set segment re-map 95 to 0
  LCD_WrCmd(0xa6);//--set normal display
  LCD_WrCmd(0xa8);//--set multiplex ratio(1 to 64)
  LCD_WrCmd(0x3f);//--1/64 duty
  LCD_WrCmd(0xd3);//-set display offset
  LCD_WrCmd(0x00);//-not offset
  LCD_WrCmd(0xd5);//--set display clock divide ratio/oscillator frequency
  LCD_WrCmd(0x80);//--set divide ratio
  LCD_WrCmd(0xd9);//--set pre-charge period
  LCD_WrCmd(0xf1);
  LCD_WrCmd(0xda);//--set com pins hardware configuration
  LCD_WrCmd(0x12);
  LCD_WrCmd(0xdb);//--set vcomh
  LCD_WrCmd(0x40);
  LCD_WrCmd(0x8d);//--set Charge Pump enable/disable
  LCD_WrCmd(0x14);//--set(0x10) disable
  LCD_WrCmd(0xaf);//--turn on oled panel
  */
	
} 
/**********************************************************
函数名称：OLED_PutPixel
函数功能：绘制一个点（x,y）
入口参数：真实坐标值(x,y),x的范围0～127，y的范围0～64
出口参数：无  
***********************************************************/
void OLED_PutPixel(uint8 x,uint8 y)
{
	uint8 data1;  //data1当前点的数据  
	LCD_Set_Pos(x,y); 
	data1 = 0x01<<(y%8); 	
	LCD_WrCmd(0xb0+(y>>3));
	LCD_WrCmd(((x&0xf0)>>4)|0x10);
	LCD_WrCmd((x&0x0f)|0x00);
	LCD_WrDat(data1); 	 	
}
/**********************************************************
函数名称：OLED_Printf_Str
函数功能：写入一组标准ASCII字符串 
入口参数：显示的位置（x,y），y为页范围0～7，要显示的字符串
出口参数：无  
***********************************************************/
void OLED_Printf_Str(uint8 x,uint8 y,uint8 ch[])
{
  uint8 c=0,i=0,j=0;      
  while (ch[j]!='\0')
  {    
    c =ch[j]-32;
    if(x>126){x=0;y++;}
    LCD_Set_Pos(x,y);    
  	for(i=0;i<6;i++)     
  	  LCD_WrDat(font6x8[c][i]);  
  	x+=6;
  	j++;
  }
}
/**********************************************************
函数名称：LCD_P14x16Str
函数功能：写入一组汉字 
入口参数：显示的位置（x,y），汉字字符串
出口参数：无  
***********************************************************/
void OLED_P14x16Str(uint8 x,uint8 y,uint8 ch[])
{
	uint8 wm=0,ii = 0;
	uint16 adder=1; 
	
	while(ch[ii] != '\0')
	{
  	wm = 0;
  	adder = 1;
  	while(F14x16_Idx[wm] > 127)
  	{
  		if(F14x16_Idx[wm] == ch[ii])
  		{
  			if(F14x16_Idx[wm + 1] == ch[ii + 1])
  			{
  				adder = wm * 14;
  				break;
  			}
  		}
  		wm += 2;			
  	}
  	if(x>118){x=0;y++;}
  	LCD_Set_Pos(x , y); 
  	if(adder != 1)// 显示汉字					
  	{
  		LCD_Set_Pos(x , y);
  		for(wm = 0;wm < 14;wm++)               
  		{
  			LCD_WrDat(F14x16[adder]);	
  			adder += 1;
  		}      
  		LCD_Set_Pos(x,y + 1); 
  		for(wm = 0;wm < 14;wm++)          
  		{
  			LCD_WrDat(F14x16[adder]);
  			adder += 1;
  		}   		
  	}
  	else			  //显示空白字符			
  	{
  		ii += 1;
      LCD_Set_Pos(x,y);
  		for(wm = 0;wm < 16;wm++)
  		{
  				LCD_WrDat(0);
  		}
  		LCD_Set_Pos(x,y + 1);
  		for(wm = 0;wm < 16;wm++)
  		{   		
  				LCD_WrDat(0);	
  		}
  	}
  	x += 14;
  	ii += 2;
	}
}
void LCD_Print(uint8 x, uint8 y, uint8 ch[])
{
	uint8 ch2[3];
	uint8 ii=0;        
	while(ch[ii] != '\0')
	{
		if(ch[ii] > 127)
		{
			ch2[0] = ch[ii];
	 		ch2[1] = ch[ii + 1];
			ch2[2] = '\0';			//汉字为两个字节
			OLED_P14x16Str(x , y, ch2);	//显示汉字
			x += 14;
			ii += 2;
		}
		else
		{
			ch2[0] = ch[ii];	
			ch2[1] = '\0';			//字母占一个字节
			OLED_Printf_Str(x , y , ch2);	//显示字母
			x += 8;
			ii+= 1;
		}
	}
} 




/**************************************不画图 屏蔽掉*******************************/

//==============================================================
//函数名： void Draw_BMP(uint8 x,uint8 y)
//功能描述：显示BMP图片128×64
//参数：起始点坐标(x,y),x的范围0～127，y为页的范围0～7
//返回：无
//==============================================================
void Draw_BMP(uint8 x0,uint8 y0,uint8 x1,uint8 y1,uint8 bmp[])
{ 	
  uint16 ii=0;
  uint8 x,y;
  
  if(y1%8==0) y=y1/8;      
  else y=y1/8+1;
	for(y=y0;y<=y1;y++)
	{
		LCD_Set_Pos(x0,y);				
    for(x=x0;x<x1;x++)
	    {      
	    	LCD_WrDat(bmp[ii++]);	    	
	    }
	}
}


/*********************************************************** 
函数名称：OLED_Picture
函数功能：显示图像
入口参数：无
出口参数：无  
***********************************************************/
void OLED_picture_hang(unsigned char X,unsigned char Y,unsigned char LCD_high,uint8*Image_,uint8 Image_length)
{
    unsigned int i;
    signed int n;
    unsigned char *p;
    unsigned char CCD_temp[84];
    p=CCD_temp;
    //构造5110显示数组
    for (n=0;n<160;n=n+2)
    {
        *p = (Image_[n+LCD_high*Image_length]-254) +(Image_[n+(LCD_high+1)*Image_length]-254)*2+ 
        	 (Image_[n+(LCD_high+2)*Image_length]-254)*4+ (Image_[n+(LCD_high+3)*Image_length]-254)*8+
             (Image_[n+(LCD_high+4)*Image_length]-254)*16+(Image_[n+(LCD_high+5)*Image_length]-254)*32+
             (Image_[n+(LCD_high+6)*Image_length]-254)*64+(Image_[n+(LCD_high+7)*Image_length]-254)*128;    
        p++;
    }
    CCD_temp[80]=0xff;
    LCD_Set_Pos(X,Y);
    //显示一行图像
    for(i=0; i<=80; i++)//80
    {
    	LCD_WrDat(CCD_temp[i]);
    }
}

void OLED_picture(uint8*I,uint8 length,int8 D_start)
{
	int i;
	for(i=0;i<(60-D_start)/8;i++)//
	{
		OLED_picture_hang(0,i,D_start+i*8,I,length);
	}
}

/**********************************************************
函数名称：OLED_Print_num_int
函数功能：屏幕打印整数数字函数 
入口参数：坐标x,y  数字num
出口参数：无  
***********************************************************/
void OLED_Print_num_int(int8 x, int8 y, int num)
{
	char NUM[8];
	uint8 c=0,i=0,j=0;
	sprintf(NUM, "%d", num);
	while (NUM[j]!='\0')
	{    
	    c =NUM[j]-32;
	    if(x>126){x=0;y++;}
	    LCD_Set_Pos(x,y);    
	  	for(i=0;i<6;i++)     
	  	  LCD_WrDat(font6x8[c][i]);  
	  	x+=6;
	  	j++;
	}	
}
/**********************************************************
函数名称：OLED_Print_num_float
函数功能：屏幕打印浮点型数字函数 
入口参数：坐标x,y  数字num
出口参数：无  
***********************************************************/
void OLED_Print_num_float(int8 x, int8 y, float num)
{
	char NUM[10]={0};
	uint8 c=0,i=0,j=0;
	sprintf(NUM, "%.2" ,num);
	while (NUM[j]!='\0')
	{    
	    c =NUM[j]-32;
	    if(x>126){x=0;y++;}
	    LCD_Set_Pos(x,y);    
	  	for(i=0;i<6;i++)     
	  	LCD_WrDat(font6x8[c][i]);  
	  	x+=6;
	  	j++;
	}	
}



/**********************************************************
函数名称：LCD_show_all
函数功能：LCD图像及中线显示函数 
入口参数：image 图像数组   length数组长度  center中线数组 D_start展示部分图像起始行数
出口参数：无  
编写方法：遍历整个数组；
***********************************************************/
static void OLED_show_all_long(unsigned char X,unsigned char Y,unsigned char LCD_high,uint8*Image_,uint8 Image_length,int16 *center)
{
	unsigned int i;
	signed int n;
	int temp=1;
	unsigned char *p;
	unsigned char CCD_temp[84];
	p=CCD_temp;
	//构造5110显示数组
	for (n=0;n<160;n=n+2)
   	{
        *p = (Image_[n+LCD_high*Image_length]-254) +(Image_[n+(LCD_high+1)*Image_length]-254)*2+ 
        	 (Image_[n+(LCD_high+2)*Image_length]-254)*4+ (Image_[n+(LCD_high+3)*Image_length]-254)*8+
            (Image_[n+(LCD_high+4)*Image_length]-254)*16+(Image_[n+(LCD_high+5)*Image_length]-254)*32+
             (Image_[n+(LCD_high+6)*Image_length]-254)*64+(Image_[n+(LCD_high+7)*Image_length]-254)*128;    
        p++;
    }
    CCD_temp[80]=0x00;
    LCD_Set_Pos(X,Y);
    //显示一行图像
   for(i=0; i<80; i++)
    {
    	CCD_temp[i]=~CCD_temp[i];
    }
    temp=1;
    for(n=0;n<8;n++)
	{
		if(((center[LCD_high])/2) > 80)
		{
			CCD_temp[80] = CCD_temp[80]  ^ temp;	
		} 
		else if(((center[LCD_high])/2) < 0 )
		{
			CCD_temp[0]  = CCD_temp[0]  ^ temp;
		}
		else
		{
			CCD_temp[((center[LCD_high])/2)] = CCD_temp[((center[LCD_high])/2)] ^ temp;	
		}
		temp=temp*2;
		LCD_high++;	
	}
	for(i=0; i<=80; i++)
    {
    	LCD_WrDat(~CCD_temp[i]);
    }	
}

void OLED_show_all(uint8*I,uint8 length,int16 *center,int8 D_start)
{
	int i=0;
	for(i=0;i<(60-D_start)/8;i++)
	{
		OLED_show_all_long(0,i, D_start+i*8,I,length,center);
	}
}